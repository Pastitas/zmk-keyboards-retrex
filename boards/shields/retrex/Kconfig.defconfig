## boards/shields/retrex/Kconfig.defconfig
```kconfig
# Copyright (c) 2021 The ZMK Contributors
# SPDX-License-Identifier: MIT
if SHIELD_RETREX_LEFT

config ZMK_KEYBOARD_NAME
    default "Retrex"

config ZMK_SPLIT_ROLE_CENTRAL
    default y

endif

if SHIELD_RETREX_LEFT || SHIELD_RETREX_RIGHT

config ZMK_SPLIT
    default y

endif
```

## boards/shields/retrex/Kconfig.shield
```kconfig
# Copyright (c) 2021 The ZMK Contributors
# SPDX-License-Identifier: MIT
config SHIELD_RETREX_LEFT
    def_bool $(shields_list_contains,retrex_left)

config SHIELD_RETREX_RIGHT
    def_bool $(shields_list_contains,retrex_right)
```
